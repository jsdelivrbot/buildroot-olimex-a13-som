## buildroot/configs/a13_som_defconfig
```kconfig
BR2_arm=y
BR2_cortex_a8=y
BR2_ARM_FPU_VFPV3=y
BR2_TOOLCHAIN_BUILDROOT_WCHAR=y
BR2_TARGET_GENERIC_HOSTNAME="oli-a13-som"
BR2_TARGET_GENERIC_ISSUE="Welcome to oli-Buildroot"
BR2_LINUX_KERNEL=y
BR2_LINUX_KERNEL_DEFCONFIG="sunxi"
BR2_LINUX_KERNEL_DTS_SUPPORT=y
BR2_LINUX_KERNEL_INTREE_DTS_NAME="sun5i-a13-olinuxino-micro"
BR2_PACKAGE_MAKE=y
BR2_PACKAGE_PHP=y
BR2_PACKAGE_PHP_SAPI_CLI_CGI=y
BR2_PACKAGE_PYTHON=y
BR2_PACKAGE_SUDO=y
BR2_PACKAGE_NANO=y
```
